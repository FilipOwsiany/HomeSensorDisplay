## meta-display/conf/layer.conf
```bitbake
# We have a conf and classes directory, add to BBPATH
BBPATH .= ":${LAYERDIR}"

# We have recipes-* directories, add to BBFILES
BBFILES += "${LAYERDIR}/recipes-*/*/*.bb \
            ${LAYERDIR}/recipes-*/*/*.bbappend"

BBFILE_COLLECTIONS += "meta-display"
BBFILE_PATTERN_meta-display = "^${LAYERDIR}/"
BBFILE_PRIORITY_meta-display = "6"

LAYERDEPENDS_meta-display = "core"
LAYERSERIES_COMPAT_meta-display = "scarthgap"
```

## meta-display/conf/machine/raspberrypi5-display.conf
```bitbake
require conf/machine/raspberrypi5.conf

MACHINEOVERRIDES =. "raspberrypi5:"
KMACHINE = "bcm2712"

MACHINEOVERRIDES =. "raspberrypi5-display:"

RPI_EXTRA_CONFIG:append = "\ndtoverlay=vc4-kms-dsi-ili9881-7inch,dsi1\n"
CMDLINE:append = " quiet loglevel=0 audit=0 vt.global_cursor_default=0"
```

## meta-gateway/conf/layer.conf
```bitbake
BBPATH .= ":${LAYERDIR}"
BBFILES += "${LAYERDIR}/recipes-*/*/*.bb ${LAYERDIR}/recipes-*/*/*.bbappend"

BBFILE_COLLECTIONS += "gateway"
BBFILE_PATTERN_gateway = "^${LAYERDIR}/"
BBFILE_PRIORITY_gateway = "6"

LAYERSERIES_COMPAT_gateway = "scarthgap"
```

## meta-gateway/conf/machine/raspberrypi5-gateway.conf
```bitbake
# Maszyna: Raspberry Pi 5 + własne rozszerzenia
# Dziedziczymy wszystko z bazowej maszyny raspberrypi5
require conf/machine/raspberrypi5.conf

MACHINEOVERRIDES =. "raspberrypi5:"
KMACHINE = "bcm2712"

# Dodatki do /boot/config.txt
RPI_EXTRA_CONFIG:append = "\n\
dtoverlay=disable-bt\n\
enable_uart=1\n\
gpio=14=alt0,15=alt0\n\
dtoverlay=vc4-kms-v3d\n\
dtoverlay=vc4-kms-dsi-ili9881-7inch,dsi1\n\
"

# Dodatki do /boot/cmdline.txt
CMDLINE:append = " console=serial0,115200 console=tty1"

# Getty (login prompt) na głównym UART
SERIAL_CONSOLES ?= "115200;ttyAMA0"
```
